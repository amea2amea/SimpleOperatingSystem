# リンカスクリプトの作成
# リンカスクリプトは、プログラムの各データ領域をメモリ上にどう配置するかを定義するファイル

# エントリーポイントの指定:()の中がエントリー関数となる
ENTRY(boot)

# セクション
# 全ファイル中 (「*」) の.textと.text.で始まる名前のセクションを配置
SECTIONS{
    # 実行イメージのベース位置 (OpenSBIから呼ばれる)
    # BOOT処理を行い、カーネルのエントリーポイント(メイン関数)に設定する必要がある
    # OpenSBIは、0x80000000から使用しており、処理完了後に0x80200000へジャンプ処理をする
    . = 0x80200000;

    # コード領域
    .text : {
        KEEP(*(.text.boot));
        *(.text .text.*);          
    }
    # 読み込み可能なデータ領域 (constなどの定数データ)
    .rodata : {
        *(.rodata .rodata.*);
    }
    # 読み書き可能なデータ領域 (初期値ありのグローバル変数)
    .data : {
        *(.data .data.*);
    }
    # 読み書き可能なデータ領域 (初期値なしのグローバル変数:0クリアされる)
    .bss : {
        *(.bss .bss.*);
    }
}